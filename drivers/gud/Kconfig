## drivers/gud/Kconfig
```kconfig
config TRUSTONIC_TEE
    tristate "Trustonic TEE Driver"
    depends on ARM64
    default n
    help
      Enable Trustonic TEE support

config TRUSTONIC_TEE_DEBUG
    bool "Trustonic TEE driver debug mode"
    depends on TRUSTONIC_TEE
    default n

config RSU_SELECT_SILVER_CORES
    bool "Force Trustonic TEE schedule run in silver cores"
    depends on TRUSTONIC_TEE
    default n

config RSU_SELECT_INTERNAL_CLOCK
    bool "Use internal clock for qcom_seecom"
    depends on TRUSTONIC_TEE
    default n
```

## drivers/input/misc/goodix_fod_mmi/Kconfig
```kconfig
config INPUT_GOODIX_FOD_MMI
	tristate "Finger print card goodix MMI"
	depends on INPUT_MISC
	default n
	help
	  Say Y here to enable support for retrieving self-test reports.

	  If unsure, say N.

	  To compile this driver as a module, choose M here.
```
